// ESP32 DevKitV1 port of firmware/src/lab_tx.c + lab_console.c.
//
// Same console grammar, same measured HCS301-shaped timing constants, same
// disclaimer: this sends exactly the hopping/serial/button fields it's told
// to send. It does not perform KeeLoq encryption and does not derive or
// guess any key material.
//
// Console is Bluetooth Classic SPP ("ESP32-KeeLoq-Lab") instead of USB CDC.
// Transmit timing is generated by the RMT peripheral instead of a busy-wait
// loop, so it isn't subject to BT-stack jitter the way a bit-banged GPIO
// loop would be.
//
// The inter-frame gap is part of the RMT waveform too, and every frame of a
// burst is enqueued as its own transaction before the first one finishes. That
// matters: an earlier version paused between frames with delayMicroseconds(),
// which is a busy-wait that the Bluetooth controller's high-priority interrupt
// stretches by an unpredictable amount, so the ~102 ms frame cadence wandered.
// With the gap encoded and the transactions chained, the whole burst is
// hardware-timed and the CPU is not in the path at all.
//
// Wiring: STX882 DATA pin -> GPIO (TX_GPIO below), GND common, VCC per module
// (STX882 modules typically run 3.3-12V; the DATA line itself is a logic
// input and tolerates 3.3V from the ESP32).

#include "BluetoothSerial.h"
#include "driver/rmt_tx.h"
#include "driver/rmt_encoder.h"
#include <string.h>

#if !defined(CONFIG_BT_ENABLED) || !defined(CONFIG_BLUEDROID_ENABLED)
#error "Bluetooth is not enabled. Select an ESP32 board variant with BT, and enable it in Tools > Partition Scheme / Arduino configuration."
#endif

// Using the modern IDF 5.x RMT TX driver (rmt_tx.h), not the deprecated
// driver/rmt.h legacy shim -- that shim silently dropped every other
// transition on this core version (confirmed by RF capture: half the
// expected edges, each ~double the expected duration).
static const gpio_num_t TX_GPIO = GPIO_NUM_4;
static rmt_channel_handle_t tx_channel = NULL;
static rmt_encoder_handle_t copy_encoder = NULL;

// ---- measured timing constants, mirrored from firmware/src/lab_tx.c ----
#define PREAMBLE_EDGE_US   760U
#define HEADER_BIT_ZERO_US 4512U
#define HEADER_BIT_ONE_US  4170U
#define DATA_SHORT_US      795U
#define DATA_MID_US        1138U
#define DATA_LONG_US       1482U
#define INTER_FRAME_GAP_US 15500U

#define ORIGINAL_SERIAL   0x0FB58C0CUL
#define COPIER_SERIAL     0x01114F9AUL
#define ORIGINAL_BUTTON_1 0x02U
#define STALE_HOPPING     0xBBA8D1CAUL

#define DEFAULT_FRAMES 3U
#define MAX_FRAMES 10U

#define FRAME_EDGES 77U

// 11 preamble + 1 header + 65 data edges, plus the inter-frame gap edge, is 78
// edges -- exactly 39 two-edge RMT symbols. A 40th, all-zero symbol is appended
// as an explicit end-of-transmission marker: the RMT hardware stops when it
// meets a zero duration, and leaving that to the driver is how frames get
// truncated.
#define FRAME_SYMBOLS 40U

static uint16_t plaintext_counter = 1U;
static uint32_t prng_state = 0x6D2B79F5UL;

// One encoded frame per transmit, all alive at once: rmt_transmit() hands the
// payload to the driver asynchronously, so these must not be reused or freed
// until the burst has finished. 10 frames x 40 symbols x 4 bytes = 1600 bytes.
static rmt_symbol_word_t frame_symbols[MAX_FRAMES][FRAME_SYMBOLS];

BluetoothSerial SerialBT;

// ---- RMT waveform construction, mirroring lab_tx.c's send_bits_once ----

// One clock tick = 1us (80MHz APB / 80 divider).
struct Edge {
    uint8_t level;
    uint16_t duration_us;
};

// 11 preamble edges + 1 header edge + 65 data edges = 77 edges per frame,
// same structure as the STM32 version.
static void build_frame_edges(const uint8_t bits[66], Edge edges[77]) {
    uint8_t level = 1U;
    for (uint8_t i = 0; i < 11U; ++i) {
        edges[i].level = level;
        edges[i].duration_us = PREAMBLE_EDGE_US;
        level ^= 1U;
    }
    edges[11].level = level;
    edges[11].duration_us = bits[0] ? HEADER_BIT_ONE_US : HEADER_BIT_ZERO_US;
    level ^= 1U;
    for (uint8_t i = 0; i < 65U; ++i) {
        uint16_t duration = DATA_MID_US;
        if (!bits[i] && bits[i + 1U]) {
            duration = DATA_SHORT_US;
        } else if (bits[i] && !bits[i + 1U]) {
            duration = DATA_LONG_US;
        }
        edges[12U + i].level = level;
        edges[12U + i].duration_us = duration;
        level ^= 1U;
    }
}

// Pack one frame plus its trailing low gap into RMT symbols. The gap edge is
// what makes the burst self-timed: the line stays low for INTER_FRAME_GAP_US
// as part of the waveform, and the next transaction starts immediately after.
static void encode_frame(const uint8_t bits[66],
                         rmt_symbol_word_t symbols[FRAME_SYMBOLS]) {
    Edge edges[FRAME_EDGES + 1U];
    build_frame_edges(bits, edges);

    // Frame body ends by returning to idle low, so the gap edge is always low.
    edges[FRAME_EDGES].level = 0U;
    edges[FRAME_EDGES].duration_us = INTER_FRAME_GAP_US;

    memset(symbols, 0, sizeof(rmt_symbol_word_t) * FRAME_SYMBOLS);
    for (uint8_t i = 0; i < FRAME_EDGES + 1U; ++i) {
        rmt_symbol_word_t *symbol = &symbols[i / 2U];
        if ((i & 1U) == 0U) {
            symbol->level0 = edges[i].level;
            symbol->duration0 = edges[i].duration_us;
        } else {
            symbol->level1 = edges[i].level;
            symbol->duration1 = edges[i].duration_us;
        }
    }
    // symbols[FRAME_SYMBOLS - 1] stays zeroed: duration 0 ends the transaction.
}

static bool tx_send_codeword(uint32_t hopping, uint32_t serial, uint8_t button,
                             uint8_t frame_count) {
    if (tx_channel == NULL || copy_encoder == NULL) {
        return false;
    }
    if (frame_count == 0U) {
        return false;
    }
    if (frame_count > MAX_FRAMES) {
        frame_count = MAX_FRAMES;
    }
    serial &= 0x0FFFFFFFUL;
    button &= 0x0FU;

    // The code word is the same in every frame except the repeat bit, so build
    // it once and flip bit 65 as each frame is encoded.
    uint8_t bits[66];
    for (uint8_t i = 0; i < 32U; ++i) {
        bits[i] = (uint8_t)((hopping >> i) & 1U);
    }
    for (uint8_t i = 0; i < 28U; ++i) {
        bits[32U + i] = (uint8_t)((serial >> i) & 1U);
    }
    for (uint8_t i = 0; i < 4U; ++i) {
        bits[60U + i] = (uint8_t)((button >> i) & 1U);
    }
    bits[64] = 0U;  // VLOW

    for (uint8_t frame = 0; frame < frame_count; ++frame) {
        bits[65] = (frame == 0U) ? 0U : 1U;  // repeat
        encode_frame(bits, frame_symbols[frame]);
    }

    // Queue the whole burst before waiting: the driver chains transactions
    // back to back, so no software gap is inserted between frames.
    rmt_transmit_config_t tx_config = {};
    tx_config.loop_count = 0;
    for (uint8_t frame = 0; frame < frame_count; ++frame) {
        esp_err_t err = rmt_transmit(tx_channel, copy_encoder,
                                     frame_symbols[frame],
                                     sizeof(frame_symbols[frame]), &tx_config);
        if (err != ESP_OK) {
            return false;
        }
    }

    // A frame is ~102 ms including its gap; allow headroom for the last one.
    // The previous fixed 1000 ms was shorter than a full 10-frame burst.
    const uint32_t timeout_ms = 200U + (uint32_t)frame_count * 120U;
    return rmt_tx_wait_all_done(tx_channel, timeout_ms) == ESP_OK;
}

static bool tx_run_scenario(uint8_t command) {
    switch (command) {
    case 's':
        return tx_send_codeword(STALE_HOPPING, ORIGINAL_SERIAL,
                                 ORIGINAL_BUTTON_1, 3U);
    case 'z':
        return tx_send_codeword(0U, ORIGINAL_SERIAL, ORIGINAL_BUTTON_1, 3U);
    case 'p': {
        uint32_t hopping = (uint32_t)plaintext_counter++ |
                           ((ORIGINAL_SERIAL & 0x3FFUL) << 16) |
                           ((uint32_t)ORIGINAL_BUTTON_1 << 28);
        return tx_send_codeword(hopping, ORIGINAL_SERIAL, ORIGINAL_BUTTON_1,
                                 3U);
    }
    case 'x':
        prng_state ^= prng_state << 13;
        prng_state ^= prng_state >> 17;
        prng_state ^= prng_state << 5;
        return tx_send_codeword(prng_state, ORIGINAL_SERIAL,
                                 ORIGINAL_BUTTON_1, 3U);
    case 'd':
        return tx_send_codeword(0U, COPIER_SERIAL, ORIGINAL_BUTTON_1, 3U);
    default:
        return false;
    }
}

// ---- console: same grammar as firmware/src/lab_console.c ----

#define LINE_CAPACITY 48U
static char line[LINE_CAPACITY];
static uint8_t line_length = 0U;

// Set by the first byte of a frame that is not printable ASCII. Such a frame
// can only be a COBS-encoded binary packet, so it is reassembled until the
// 0x00 delimiter instead of being treated as a console line. A text line
// never sets it, which is what keeps the two input formats from colliding.
static bool rx_has_nonprintable = false;

// Latched once a valid binary packet has been accepted: from then on the
// text console stays completely silent, because a banner or a "> " prompt in
// the middle of the packet stream looks like a corrupt frame to the host.
static bool binary_mode = false;

static void send_text(const char *value) {
    if (!binary_mode) {
        SerialBT.print(value);
    }
}

static void send_hex(uint32_t value, uint8_t digits) {
    static const char alphabet[] = "0123456789abcdef";
    char text[9];
    uint8_t i = digits;
    text[digits] = '\0';
    while (i-- > 0U) {
        text[i] = alphabet[value & 0xFU];
        value >>= 4;
    }
    send_text(text);
}

static void send_decimal(uint32_t value) {
    char text[11];
    uint8_t i = sizeof(text) - 1U;
    text[i] = '\0';
    do {
        text[--i] = (char)('0' + (value % 10U));
        value /= 10U;
    } while (value != 0U);
    send_text(&text[i]);
}

static void send_menu() {
    send_text(
        "\r\nESP32 KeeLoq tabletop lab (Bluetooth)\r\n"
        "Commands:\r\n"
        "  tx <hopping> <serial> <button> [frames]\r\n"
        "     frames 1-10; 15.5 ms gap inside the waveform, ~102 ms per frame\r\n"
        "     e.g. tx CF3EED68 FB3EC77 2 10   (~1 s burst)\r\n"
        "  synthetic-stale\r\n"
        "  zero-hop\r\n"
        "  plaintext-counter\r\n"
        "  random-hop\r\n"
        "  different-serial\r\n"
        "  help\r\n"
        "> ");
}

struct Mapping {
    const char *name;
    uint8_t command;
};
static const Mapping mappings[] = {
    {"synthetic-stale", 's'},  {"zero-hop", 'z'},   {"plaintext-counter", 'p'},
    {"random-hop", 'x'},       {"different-serial", 'd'},
    {"s", 's'}, {"z", 'z'}, {"p", 'p'}, {"x", 'x'}, {"d", 'd'},
};

static bool scenario_for_line(const char *value, uint8_t *command) {
    for (size_t i = 0; i < sizeof(mappings) / sizeof(mappings[0]); ++i) {
        if (strcmp(value, mappings[i].name) == 0) {
            *command = mappings[i].command;
            return true;
        }
    }
    return false;
}

static const char *scenario_name(uint8_t command) {
    switch (command) {
    case 's': return "synthetic-stale";
    case 'z': return "zero-hop";
    case 'p': return "plaintext-counter";
    case 'x': return "random-hop";
    case 'd': return "different-serial";
    default: return "unknown";
    }
}

static bool parse_hex(const char *text, uint32_t *value) {
    if (text == NULL || *text == '\0') {
        return false;
    }
    uint32_t accumulator = 0;
    uint8_t digits = 0;
    for (const char *p = text; *p != '\0' && *p != ' '; ++p) {
        uint32_t nibble;
        if (*p >= '0' && *p <= '9') {
            nibble = (uint32_t)(*p - '0');
        } else if (*p >= 'a' && *p <= 'f') {
            nibble = (uint32_t)(*p - 'a' + 10);
        } else {
            return false;
        }
        if (digits >= 8U) {
            return false;
        }
        accumulator = (accumulator << 4) | nibble;
        ++digits;
    }
    *value = accumulator;
    return true;
}

static const char *peek_token(const char *text) {
    while (*text == ' ') {
        ++text;
    }
    return (*text == '\0') ? NULL : text;
}

static bool token_equals(const char *token, const char *name) {
    size_t i = 0;
    while (name[i] != '\0') {
        if (token[i] != name[i]) {
            return false;
        }
        ++i;
    }
    return token[i] == '\0' || token[i] == ' ';
}

static char *next_token(char **cursor) {
    char *p = *cursor;
    while (*p == ' ') {
        ++p;
    }
    if (*p == '\0') {
        *cursor = p;
        return NULL;
    }
    char *start = p;
    while (*p != '\0' && *p != ' ') {
        ++p;
    }
    if (*p == ' ') {
        *p = '\0';
        ++p;
    }
    *cursor = p;
    return start;
}

static uint8_t count_tokens(const char *text) {
    uint8_t count = 0;
    while (*text != '\0') {
        while (*text == ' ') {
            ++text;
        }
        if (*text == '\0') {
            break;
        }
        ++count;
        while (*text != '\0' && *text != ' ') {
            ++text;
        }
    }
    return count;
}

static void execute_tx(char *cursor) {
    char *hopping_text = next_token(&cursor);
    char *serial_text = next_token(&cursor);
    char *button_text = next_token(&cursor);
    char *frames_text = next_token(&cursor);
    char *extra = next_token(&cursor);

    uint32_t hopping = 0, serial = 0, button = 0, frames = DEFAULT_FRAMES;

    if (hopping_text == NULL || serial_text == NULL || button_text == NULL ||
        extra != NULL || !parse_hex(hopping_text, &hopping) ||
        !parse_hex(serial_text, &serial) || !parse_hex(button_text, &button) ||
        button > 0xFU ||
        (frames_text != NULL && !parse_hex(frames_text, &frames))) {
        send_text("Usage: tx <hopping> <serial> <button> [frames]\r\n"
                  "  e.g. tx CF3EED68 FB3EC77 2 5\r\n> ");
        return;
    }
    if (frames == 0U) {
        frames = 1U;
    }
    if (frames > MAX_FRAMES) {
        frames = MAX_FRAMES;
    }

    send_text("TX hopping=0x");
    send_hex(hopping, 8);
    send_text(" serial=0x");
    send_hex(serial, 7);
    send_text(" button=0x");
    send_hex(button, 1);
    send_text(" frames=");
    send_decimal(frames);
    send_text("\r\n");

    bool ok = tx_send_codeword(hopping, serial, (uint8_t)button, (uint8_t)frames);
    send_text(ok ? "DONE\r\n> " : "ERROR\r\n> ");
}

static void execute_line() {
    line[line_length] = '\0';
    if (line_length == 0U) {
        send_text("> ");
        return;
    }
    if (strcmp(line, "help") == 0 || strcmp(line, "?") == 0) {
        send_menu();
        return;
    }

    const char *first = peek_token(line);
    if (first == NULL) {
        send_text("> ");
        return;
    }

    uint8_t tokens = count_tokens(line);

    if (token_equals(first, "tx")) {
        char *cursor = line;
        (void)next_token(&cursor);
        execute_tx(cursor);
        return;
    }

    uint8_t command;
    if (tokens == 1U && scenario_for_line(first, &command)) {
        send_text("RUN ");
        send_text(scenario_name(command));
        send_text("\r\n");
        bool ok = tx_run_scenario(command);
        send_text(ok ? "DONE\r\n> " : "ERROR\r\n> ");
        return;
    }

    uint32_t ignored;
    if (parse_hex(first, &ignored)) {
        execute_tx(line);
        return;
    }

    send_text("Unknown command. Type help.\r\n> ");
}

// ---- binary packet protocol ------------------------------------------------
//
// Wire-compatible with firmware/src/transport.c, so the Android app's
// PacketCodec/Cobs/Reassembler speak to this board unchanged:
//
//   TX_COMMAND       [version][type=3][hopping LE32][serial LE32][button]
//                    [frame_count][crc16 LE]                    (14 bytes)
//   SCENARIO_COMMAND [version][type=4][command_char][crc16 LE]    (5 bytes)
//   ACK              [version][type=5][for_type][accepted][crc16 LE] (6 bytes)
//   STATUS           same 18-byte header + 5 words as FRAME, type 2 (30 bytes)
//
// Every packet is a COBS body followed by a single 0x00 delimiter, with
// CRC-16/CCITT over everything except the trailing CRC. STATUS is sent once a
// second while a host is connected: the app treats three seconds without one
// as a stale link, so it is a liveness requirement, not telemetry.
//
// This board has no receive path, so FRAME is never sent; the app's Receive
// screen stays STM32-only.

#define TRANSPORT_VERSION 1U
#define PKT_TYPE_STATUS 2U
#define PKT_TYPE_TX_COMMAND 3U
#define PKT_TYPE_SCENARIO_COMMAND 4U
#define PKT_TYPE_ACK 5U

#define TX_COMMAND_SIZE 14U
#define SCENARIO_COMMAND_SIZE 5U
#define STATUS_PACKET_SIZE 30U
#define ENCODED_PACKET_MAX 48U
#define STATUS_PERIOD_MS 1000U
#define ESP32_APB_HZ 80000000UL

static uint16_t packet_sequence;
static uint16_t dropped_packets;
static uint32_t last_status_ms;
static bool client_was_connected;

static void put_u16(uint8_t *buffer, size_t offset, uint16_t value) {
    buffer[offset] = (uint8_t)(value & 0xFFU);
    buffer[offset + 1U] = (uint8_t)(value >> 8U);
}

static void put_u32(uint8_t *buffer, size_t offset, uint32_t value) {
    buffer[offset] = (uint8_t)(value & 0xFFU);
    buffer[offset + 1U] = (uint8_t)((value >> 8U) & 0xFFU);
    buffer[offset + 2U] = (uint8_t)((value >> 16U) & 0xFFU);
    buffer[offset + 3U] = (uint8_t)(value >> 24U);
}

static uint32_t get_u32_le(const uint8_t *data) {
    return (uint32_t)data[0] | ((uint32_t)data[1] << 8U) |
           ((uint32_t)data[2] << 16U) | ((uint32_t)data[3] << 24U);
}

// CRC-16/CCITT-FALSE, the same polynomial and seed as transport_crc16().
static uint16_t crc16_ccitt(const uint8_t *data, size_t length) {
    uint16_t crc = 0xFFFFU;
    for (size_t i = 0; i < length; ++i) {
        crc ^= (uint16_t)data[i] << 8U;
        for (uint8_t bit = 0; bit < 8U; ++bit) {
            crc = (crc & 0x8000U) ? (uint16_t)((crc << 1U) ^ 0x1021U)
                                  : (uint16_t)(crc << 1U);
        }
    }
    return crc;
}

// Returns the encoded length including the trailing 0x00 delimiter, matching
// transport_cobs_encode(). Returns 0 if the output buffer is too small.
static size_t cobs_encode(const uint8_t *input, size_t input_length,
                          uint8_t *output, size_t output_capacity) {
    if (!input || !output || output_capacity < 2U) {
        return 0;
    }
    size_t read_index = 0;
    size_t write_index = 1;
    size_t code_index = 0;
    uint8_t code = 1;

    while (read_index < input_length) {
        if (input[read_index] == 0U) {
            if (code_index >= output_capacity) {
                return 0;
            }
            output[code_index] = code;
            code = 1;
            code_index = write_index++;
            if (write_index > output_capacity) {
                return 0;
            }
            read_index++;
        } else {
            if (write_index >= output_capacity) {
                return 0;
            }
            output[write_index++] = input[read_index++];
            code++;
            if (code == 0xFFU) {
                output[code_index] = code;
                code = 1;
                code_index = write_index++;
                if (write_index > output_capacity) {
                    return 0;
                }
            }
        }
    }

    if (code_index >= output_capacity || write_index >= output_capacity) {
        return 0;
    }
    output[code_index] = code;
    output[write_index++] = 0U;
    return write_index;
}

// Decodes a COBS body (the bytes before the 0x00 delimiter). Returns 0 on a
// malformed body, exactly like transport_cobs_decode().
static size_t cobs_decode(const uint8_t *input, size_t input_length,
                          uint8_t *output, size_t output_capacity) {
    if (!input || !output) {
        return 0;
    }
    size_t read_index = 0;
    size_t write_index = 0;
    while (read_index < input_length) {
        uint8_t code = input[read_index];
        if (code == 0U || read_index + code > input_length + 1U) {
            return 0;
        }
        read_index++;
        for (uint8_t i = 1U; i < code; ++i) {
            if (read_index >= input_length || write_index >= output_capacity) {
                return 0;
            }
            output[write_index++] = input[read_index++];
        }
        if (code != 0xFFU && read_index < input_length) {
            if (write_index >= output_capacity) {
                return 0;
            }
            output[write_index++] = 0U;
        }
    }
    return write_index;
}

static bool send_raw(const uint8_t *raw, size_t raw_length) {
    uint8_t encoded[ENCODED_PACKET_MAX];
    size_t encoded_length =
        cobs_encode(raw, raw_length, encoded, sizeof(encoded));
    if (encoded_length == 0U) {
        return false;
    }
    if (SerialBT.write(encoded, encoded_length) != encoded_length) {
        if (dropped_packets != UINT16_MAX) {
            dropped_packets++;
        }
        return false;
    }
    return true;
}

static void send_ack(uint8_t for_type, uint8_t accepted) {
    uint8_t packet[6];
    packet[0] = TRANSPORT_VERSION;
    packet[1] = PKT_TYPE_ACK;
    packet[2] = for_type;
    packet[3] = accepted;
    uint16_t crc = crc16_ccitt(packet, 4U);
    packet[4] = (uint8_t)(crc & 0xFFU);
    packet[5] = (uint8_t)(crc >> 8U);
    send_raw(packet, sizeof(packet));
}

// Same header layout as transport_send_packet(): the app validates the total
// length field, the payload word count and the receiver id, so all three have
// to match the STM32 build even though the receive path does not exist here.
static void send_status(void) {
    uint8_t packet[STATUS_PACKET_SIZE];
    const uint16_t words[5] = {
        (uint16_t)(ESP32_APB_HZ & 0xFFFFU),
        (uint16_t)(ESP32_APB_HZ >> 16U),
        0U,  // total_edges: no capture path on this board
        0U,
        dropped_packets,
    };

    packet[0] = TRANSPORT_VERSION;
    packet[1] = PKT_TYPE_STATUS;
    put_u16(packet, 2U, 0U);  // flags
    put_u16(packet, 4U, packet_sequence++);
    put_u16(packet, 6U, (uint16_t)sizeof(packet));
    put_u32(packet, 8U, 0U);   // timestamp
    put_u16(packet, 12U, 0U);  // capture drops
    put_u16(packet, 14U, 5U);  // payload word count
    packet[16] = 0U;           // initial level
    packet[17] = 1U;           // receiver id
    for (uint8_t i = 0; i < 5U; ++i) {
        put_u16(packet, 18U + (size_t)i * 2U, words[i]);
    }
    put_u16(packet, 28U, crc16_ccitt(packet, 28U));
    send_raw(packet, sizeof(packet));
}

static void handle_binary_packet(const uint8_t *encoded, uint8_t length) {
    uint8_t decoded[16];
    size_t decoded_length =
        cobs_decode(encoded, length, decoded, sizeof(decoded));
    if (decoded_length < 4U || decoded[0] != TRANSPORT_VERSION) {
        return;
    }
    uint16_t crc = crc16_ccitt(decoded, decoded_length - 2U);
    uint16_t received = (uint16_t)decoded[decoded_length - 2U] |
                        ((uint16_t)decoded[decoded_length - 1U] << 8U);
    if (crc != received) {
        return;
    }

    // Only now is it certain the peer speaks packets: switch the console off.
    binary_mode = true;

    uint8_t type = decoded[1];
    bool accepted = false;
    if (type == PKT_TYPE_TX_COMMAND && decoded_length == TX_COMMAND_SIZE) {
        uint32_t hopping = get_u32_le(&decoded[2]);
        uint32_t serial = get_u32_le(&decoded[6]);
        uint8_t button = decoded[10];
        uint8_t frames = decoded[11];
        // Same 1..10 clamp as the text path and the STM32 firmware.
        if (frames == 0U) {
            frames = 1U;
        } else if (frames > MAX_FRAMES) {
            frames = MAX_FRAMES;
        }
        accepted = tx_send_codeword(hopping, serial, button, frames);
    } else if (type == PKT_TYPE_SCENARIO_COMMAND &&
               decoded_length == SCENARIO_COMMAND_SIZE) {
        // 'r' (stale replay) has no table on this board: tx_run_scenario()
        // returns false and the ACK says so, rather than silently doing
        // something else.
        accepted = tx_run_scenario(decoded[2]);
    } else {
        return;  // unknown or malformed: no ACK, same as the STM32 firmware
    }
    send_ack(type, accepted ? 1U : 0U);
}

// Reassembles one COBS packet or one console line, whichever the host sends.
// Splitting on 0x00 is unambiguous: a COBS body never contains one. A frame
// that saw any non-printable byte is a packet; a printable-only frame is a
// console line, terminated by '\r' or '\n' like before.
static void link_poll(void) {
    while (SerialBT.available()) {
        uint8_t value = (uint8_t)SerialBT.read();

        if (value == 0x00U) {
            if (line_length > 0U && rx_has_nonprintable) {
                handle_binary_packet((const uint8_t *)line, line_length);
            }
            line_length = 0U;
            rx_has_nonprintable = false;
            continue;
        }

        if (!rx_has_nonprintable) {
            if (value == 0x08U || value == 0x7FU) {
                if (line_length != 0U) {
                    line_length--;
                }
                continue;
            }
            if (value == '\r' || value == '\n') {
                if (line_length != 0U || value == '\r') {
                    execute_line();
                }
                line_length = 0U;
                continue;
            }
            if (value >= 0x20U && value <= 0x7EU) {
                if (value >= 'A' && value <= 'Z') {
                    value = (uint8_t)(value + ('a' - 'A'));
                }
                if (line_length + 1U < LINE_CAPACITY) {
                    line[line_length++] = (char)value;
                } else {
                    line_length = 0U;
                }
                continue;
            }
            rx_has_nonprintable = true;  // not a console line after all
        }

        if (line_length + 1U < LINE_CAPACITY) {
            line[line_length++] = (char)value;
        } else {
            line_length = 0U;
            rx_has_nonprintable = false;
        }
    }
}

// One STATUS per second while a packet-speaking host is connected. A burst can
// block this for up to ~1 s (10 frames), which is why the app tolerates three.
static void link_status_service(void) {
    bool connected = SerialBT.hasClient();
    uint32_t now = millis();

    if (connected && !client_was_connected && binary_mode) {
        send_status();
        last_status_ms = now;
    }
    client_was_connected = connected;

    if (!connected) {
        return;
    }
    if ((uint32_t)(now - last_status_ms) >= STATUS_PERIOD_MS) {
        last_status_ms = now;
        if (binary_mode) {
            send_status();
        }
    }
}

void setup() {
    SerialBT.begin("ESP32-KeeLoq-Lab");
    line_length = 0U;

    rmt_tx_channel_config_t tx_chan_config = {};
    tx_chan_config.gpio_num = TX_GPIO;
    tx_chan_config.clk_src = RMT_CLK_SRC_DEFAULT;
    tx_chan_config.resolution_hz = 1000000;  // 1 tick = 1us
    tx_chan_config.mem_block_symbols = 64;   // must be even, >= FRAME_SYMBOLS
    // One slot per frame of a burst, so every frame can be queued before the
    // first one finishes and the driver chains them without a software gap.
    tx_chan_config.trans_queue_depth = MAX_FRAMES;
    tx_chan_config.flags.invert_out = false;
    // Idle low, matching the STM32 version's inactive-low state.
    tx_chan_config.flags.init_level = 0;

    esp_err_t err = rmt_new_tx_channel(&tx_chan_config, &tx_channel);
    if (err != ESP_OK) {
        send_text("ERROR rmt_new_tx_channel\r\n");
        send_menu();
        return;
    }

    rmt_copy_encoder_config_t copy_encoder_config = {};
    err = rmt_new_copy_encoder(&copy_encoder_config, &copy_encoder);
    if (err == ESP_OK) {
        err = rmt_enable(tx_channel);
    }
    if (err != ESP_OK) {
        send_text("ERROR rmt encoder/enable\r\n");
        send_menu();
        return;
    }

    send_menu();
}

void loop() {
    link_poll();
    link_status_service();
}
